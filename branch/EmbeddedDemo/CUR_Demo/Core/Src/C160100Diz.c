#include "main.h"
#include "string.h"

extern I2C_HandleTypeDef hi2c1;

#define C160100DiZ_ADDR (0x3F << 1)
// Reset pin: PD5
#define NHD_RST_PORT GPIOD
#define NHD_RST_PIN  GPIO_PIN_6

#define NHD_CS_PORT        GPIOB
#define NHD_CS_PIN         GPIO_PIN_9

#define LCD_W 160
#define LCD_H 100
#define LCD_PAGES (LCD_H / 8)

uint8_t fb[LCD_W * LCD_PAGES];

// Set pixel in framebuffer
void set_pixel(int x, int y, int color)
{
    if (x < 0 || x >= LCD_W || y < 0 || y >= LCD_H) return;

    int page = y / 8;
    int bit  = y % 8;

    if (color)
        fb[page * LCD_W + x] |= (1 << bit);
    else
        fb[page * LCD_W + x] &= ~(1 << bit);
}

void draw_big_4(int x0, int y0)
{
    for (int y = 0; y < 40; y++)
    {
        for (int x = 0; x < 20; x++)
        {
            if ((x < 5 && y > 15) || (y > 15 && y < 20) || (x > 15))
                set_pixel(x0 + x, y0 + y, 1);
        }
    }
}

void draw_big_2(int x0, int y0)
{
    for (int y = 0; y < 40; y++)
    {
        for (int x = 0; x < 20; x++)
        {
            if ((y < 5) ||
                (y > 35) ||
                (y > 15 && y < 20) ||
                (x > 15 && y < 20) ||
                (x < 5 && y > 20))
            {
                set_pixel(x0 + x, y0 + y, 1);
            }
        }
    }
}

const uint8_t font5x7[][5] = {
    // m
    {0x00,0x1C,0x04,0x18,0x04},
    // H
    {0x1F,0x04,0x04,0x04,0x1F},
    // g
    {0x18,0x24,0x24,0x3C,0x04},
};

void draw_char(int x, int y, const uint8_t *ch)
{
    for (int col = 0; col < 5; col++)
    {
        uint8_t line = ch[col];
        for (int row = 0; row < 7; row++)
        {
            if (line & (1 << row))
                set_pixel(x + col, y + row, 1);
        }
    }
}

void draw_mmHg(int x, int y)
{
    draw_char(x + 0,  y, font5x7[0]);  // m
    draw_char(x + 6,  y, font5x7[0]);  // m
    draw_char(x + 12, y, font5x7[1]);  // H
    draw_char(x + 18, y, font5x7[2]);  // g
}

void generate_image(void)
{
    memset(fb, 0x00, sizeof(fb));

    // Center "42"
    draw_big_4(40, 20);
    draw_big_2(70, 20);

    // "mmHg" underneath
    draw_mmHg(55, 70);
}

const unsigned char NHD_Logo2[] =        //Hex values for Logo Image
{
		0x00, 0x00, 0x00, 0x00, 0x00, 0x00, 0x00, 0x00, 0x00, 0x00, 0x00, 0x00, 0x00, 0x00, 0x00, 0x00,
		0x00, 0x00, 0x00, 0x00, 0x00, 0x00, 0x00, 0x00, 0x00, 0x00, 0x00, 0x00, 0x00, 0x00, 0x00, 0x00,
		0x00, 0x00, 0x00, 0x00, 0x00, 0x00, 0x00, 0x00, 0x00, 0x00, 0x00, 0x00, 0x00, 0x00, 0x00, 0x00,
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		0x00, 0x00, 0x00, 0x00, 0x00, 0x00, 0x00, 0x00, 0x00, 0x00, 0x00, 0x00, 0x00, 0x00, 0x00, 0x00,
};



static void C160100DiZ_cmd(uint8_t cmd)
{
    uint8_t buf[2] = {0x00, cmd};
    HAL_I2C_Master_Transmit(&hi2c1, C160100DiZ_ADDR, buf, 2, HAL_MAX_DELAY);
}

static void C160100DiZ_data(uint8_t data)
{
    uint8_t buf[2] = {0x40, data};
    HAL_I2C_Master_Transmit(&hi2c1, C160100DiZ_ADDR, buf, 2, HAL_MAX_DELAY);
}

void C160100DiZ_init(void)
{
	HAL_GPIO_WritePin(NHD_RST_PORT, NHD_RST_PIN, GPIO_PIN_RESET);
	HAL_Delay(50);
	HAL_GPIO_WritePin(NHD_RST_PORT, NHD_RST_PIN, GPIO_PIN_SET);
	HAL_Delay(50);

    C160100DiZ_cmd(0x31);
    C160100DiZ_cmd(0xD7);
    C160100DiZ_data(0x9F);

    C160100DiZ_cmd(0xE0);
    C160100DiZ_data(0x00);
    HAL_Delay(10);

    C160100DiZ_cmd(0xE3);
    HAL_Delay(20);
    C160100DiZ_cmd(0xE1);
    C160100DiZ_cmd(0x30);
    C160100DiZ_cmd(0x94);
    C160100DiZ_cmd(0xAE);
    HAL_Delay(50);

    C160100DiZ_cmd(0x20);
	C160100DiZ_data(0x0B);
	HAL_Delay(100);

	C160100DiZ_cmd(0x81);
	C160100DiZ_data(0x08);
	C160100DiZ_data(0x03);

	C160100DiZ_cmd(0x31);
	C160100DiZ_cmd(0x30);
	C160100DiZ_data(0x00);
	C160100DiZ_data(0x00);
	C160100DiZ_data(0x00);
	C160100DiZ_data(0x17);
	C160100DiZ_data(0x17);
	C160100DiZ_data(0x17);
	C160100DiZ_data(0x00);
	C160100DiZ_data(0x00);
	C160100DiZ_data(0x1D);
	C160100DiZ_data(0x00);
	C160100DiZ_data(0x00);
	C160100DiZ_data(0x1D);
	C160100DiZ_data(0x1D);
	C160100DiZ_data(0x1D);
	C160100DiZ_data(0x00);
	C160100DiZ_data(0x00);

	C160100DiZ_cmd(0x32);
	C160100DiZ_data(0x00);
	C160100DiZ_data(0x01);
	C160100DiZ_data(0x03);

	C160100DiZ_cmd(0x51);
	C160100DiZ_data(0xFB);

	C160100DiZ_cmd(0x30);
	C160100DiZ_cmd(0xF0);
	C160100DiZ_data(0x10);

	C160100DiZ_cmd(0xCA);
	C160100DiZ_data(0x00);
	C160100DiZ_data(0x63);
	C160100DiZ_data(0x00);

	C160100DiZ_cmd(0xBC);
	C160100DiZ_data(0x00);

	C160100DiZ_cmd(0xA6);
	C160100DiZ_cmd(0x31);
	C160100DiZ_cmd(0x40);
	C160100DiZ_cmd(0x30);
	C160100DiZ_cmd(0x77);
	C160100DiZ_cmd(0x15);
	C160100DiZ_data(0x00);
	C160100DiZ_data(0x9F);

	C160100DiZ_cmd(0x76);
	C160100DiZ_cmd(0x30);
	C160100DiZ_cmd(0x75);
	C160100DiZ_data(0x00);
	C160100DiZ_data(0x18);

    C160100DiZ_cmd(0xAF); // Display ON
}

void C160100DiZ_Write_enable()                 //Sets writing address and allows you to begin sending image data
{
	C160100DiZ_cmd(0x75);
	C160100DiZ_data(0x00);
	C160100DiZ_data(0x18);
    C160100DiZ_cmd(0x5C);
}

void C160100DiZ_fill_screen(uint8_t d)
{
	C160100DiZ_Write_enable();
	for (int x = 0; x < 25; x++) {
		for (int n = 0; n < 80; n++) {
			C160100DiZ_data(d);
			C160100DiZ_data(d);
		}
	}
}

void C160100DiZ_checkerboard(uint8_t block_size)
{
    C160100DiZ_Write_enable();

    for (int page = 0; page < 25; page++)   // 100 rows / 4 (or 8 depending on controller)
    {
        for (int col = 0; col < 80; col++)
        {
            uint8_t byte = 0x00;

            // Build the byte bit-by-bit
            for (int bit = 0; bit < 8; bit++)
            {
                int y = (page * 8) + bit;   // actual pixel row
                int x = col * 2;            // approximate pixel column

                uint8_t x_block = x / (block_size * 2);
                uint8_t y_block = y / block_size;

                uint8_t pixel = ((x_block + y_block) % 2) ? 1 : 0;

                if (pixel)
                    byte |= (1 << bit);
            }

            C160100DiZ_data(byte);
            C160100DiZ_data(byte);
        }
    }
}

void ImageDisplay(const unsigned char *image)
{
    C160100DiZ_Write_enable();
  unsigned int i, j;
  for (i = 0; i < 12; i++) {

    for (j = 0; j < 160; j++) {  //128 columns wide
    	C160100DiZ_data(*image);           //send picture data
      image++;
    }
  }
}

void C160100DiZ_test_pattern(void)
{
	C160100DiZ_Write_enable();
    for (uint8_t page = 0; page < 13; page++)
    {
    	//C160100DiZ_cmd(0xB0 | page);
    	//C160100DiZ_cmd(0x10);
    	//C160100DiZ_cmd(0x00);

        for (int col = 0; col < 160; col++)
        {
            uint8_t pattern;

            if ((col & 1) ^ (page & 1))
                pattern = 0xAA;  // 10101010
            else
                pattern = 0x55;  // 01010101

            C160100DiZ_data(pattern);
        }
    }
}

int C160100DiZ_Test(void)
{

	C160100DiZ_init();

	C160100DiZ_checkerboard(5);
	HAL_Delay(1000);

	C160100DiZ_fill_screen(0x00);
    HAL_Delay(500);

    C160100DiZ_fill_screen(0xFF);
	HAL_Delay(500);

	ImageDisplay(NHD_Logo2);
	HAL_Delay(1000);


	//generate_image();
	//ImageDisplay(fb);
	//HAL_Delay(1000);

    return 0;
}
